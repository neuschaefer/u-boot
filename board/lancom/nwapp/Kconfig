## board/lancom/nwapp/Kconfig
```kconfig
if TARGET_LANCOM_NWAPP

config SYS_BOARD
	default "nwapp"

config SYS_VENDOR
	default "lancom"

config SYS_CONFIG_NAME
	default "lancom_nwapp"

config LANCOM_UPX_BOARD
	default "NWAPP"

config LANCOM_UPX_VERSION
	default "9.0.0"

endif
```
