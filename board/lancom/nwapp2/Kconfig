## board/lancom/nwapp2/Kconfig
```kconfig
if TARGET_LANCOM_NWAPP2

config SYS_BOARD
	default "nwapp2"

config SYS_VENDOR
	default "lancom"

config SYS_CONFIG_NAME
	default "lancom_nwapp2"

endif
```

## configs/lancom_nwapp2_defconfig
```kconfig
CONFIG_PPC=y
CONFIG_SYS_IMMR=0xe0000000
CONFIG_TEXT_BASE=0x7000000
CONFIG_SYS_MALLOC_LEN=0x200000
CONFIG_SYS_MALLOC_F_LEN=0x1000
CONFIG_ENV_SIZE=0x80000
CONFIG_ENV_OFFSET=0x80000
CONFIG_DM_GPIO=y
CONFIG_DEFAULT_DEVICE_TREE="lancom-nwapp2"
CONFIG_WATCHDOG_TIMEOUT_MSECS=2000
CONFIG_DEBUG_UART_BASE=0xe0004500
CONFIG_DEBUG_UART_CLOCK=133333333
CONFIG_SYS_CLK_FREQ=33333333
CONFIG_MPC83xx=y
CONFIG_HIGH_BATS=y
CONFIG_DEFAULT_IMMR=0xe0000000
CONFIG_TARGET_LANCOM_NWAPP2=y
CONFIG_LBLAW0=y
CONFIG_LBLAW0_BASE=0xf0000000
# CONFIG_PCI is not set
CONFIG_DEBUG_UART=y
CONFIG_LANCOM_UPX=y
CONFIG_FIT=y
CONFIG_FIT_SIGNATURE=y
CONFIG_FIT_BEST_MATCH=y
CONFIG_LEGACY_IMAGE_FORMAT=y
CONFIG_OF_BOARD_SETUP=y
CONFIG_LOG=y
CONFIG_LOG_MAX_LEVEL=9
CONFIG_LOG_DEFAULT_LEVEL=6
CONFIG_LOGF_FILE=y
CONFIG_LOGF_LINE=y
CONFIG_CMD_UFETCH=y
CONFIG_CMD_MTD=y
CONFIG_CMD_NAND=y
CONFIG_CMD_PART=y
CONFIG_CMD_MII=y
CONFIG_CMD_PING=y
CONFIG_CMD_FS_GENERIC=y
CONFIG_CMD_MTDPARTS=y
CONFIG_OF_CONTROL=y
# CONFIG_OF_TAG_MIGRATE is not set
# CONFIG_ENV_IS_IN_FLASH is not set
CONFIG_ENV_IS_IN_NAND=y
CONFIG_PROT_TCP_SACK=y
CONFIG_NET_RANDOM_ETHADDR=y
CONFIG_WGET=y
CONFIG_CLK=y
CONFIG_CPU=y
CONFIG_MPC8XXX_GPIO=y
# CONFIG_I2C is not set
# CONFIG_INPUT is not set
CONFIG_MISC=y
CONFIG_IRQ=y
CONFIG_MPC83XX_SERDES=y
# CONFIG_MMC is not set
CONFIG_MTD=y
CONFIG_DM_MTD=y
CONFIG_MTD_RAW_NAND=y
CONFIG_NAND_FSL_ELBC=y
CONFIG_NAND_FSL_ELBC_DT=y
CONFIG_PHY_ATHEROS=y
CONFIG_DM_MDIO=y
CONFIG_DM_ETH_PHY=y
CONFIG_TSEC_ENET=y
CONFIG_DM_RNG=y
# CONFIG_REQUIRE_SERIAL_CONSOLE is not set
CONFIG_SPECIFY_CONSOLE_INDEX=y
CONFIG_DM_SERIAL=y
CONFIG_SYS_NS16550=y
CONFIG_NS16550_DYNAMIC=y
CONFIG_SYSINFO=y
CONFIG_SYSRESET=y
CONFIG_SYSRESET_GPIO=y
CONFIG_WDT=y
CONFIG_WDT_GPIO=y
CONFIG_WDT_MPC8xxx=y
# CONFIG_RSA is not set
CONFIG_ZSTD=y
CONFIG_HEXDUMP=y
```

## lib/lancom_upx/Kconfig
```kconfig
# This config is selected by boards that support the UPX format.
# Additionally, they must also define the folling options:
#
# - LANCOM_UPX_BOARD (string): The board name for use in the UPX header
#
config SUPPORT_LANCOM_UPX
	def_bool n

config LANCOM_UPX_BOARD
	string
	depends on SUPPORT_LANCOM_UPX

config LANCOM_UPX_VERSION
	string
	depends on SUPPORT_LANCOM_UPX

config LANCOM_UPX
	bool "Build U-Boot as LANCOM UPX image"
	help
	  LANCOM bootloaders expect firmware images in a format called UPX.
	  If this option is enabled, U-Boot will be built as a UPX image, that
	  can be installed on LANCOM devices.
```
